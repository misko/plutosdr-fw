## package/spf_gainctl/Config.in
```kconfig
config BR2_PACKAGE_SPF_GAINCTL
	bool "spf_gainctl"
	select BR2_PACKAGE_LIBIIO
	help
	  Operator control for the tandem AGC: arms and disarms
	  FPGA-driven gain control that steps RX1 and RX2 together.

	  Only useful on a bitstream carrying the tandem AGC block.
	  Without one the tool reports that the block is absent
	  rather than acting.
```

## package/spf_metadata_source/Config.in
```kconfig
config BR2_PACKAGE_SPF_METADATA_SOURCE
	bool
	help
	  Staging-only source files and headers used by the Pluto iiOD metadata
	  provider. This is selected by the iiOD-enabled libiio package.
```

## package/starlink_pssctl/Config.in
```kconfig
config BR2_PACKAGE_STARLINK_PSSCTL
	bool "starlink_pssctl (experimental DNM firmware only)"
	help
	  Fail-closed userspace controller for the experimental Stage-15,
	  one-RX PSS TRACK_ONE FPGA block. This package belongs only in the
	  explicitly do-not-merge Starlink firmware branch.
```
